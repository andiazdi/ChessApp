#include <TimerOne.h>

int a = 0; //переменная для значения датчика
unsigned long m = 0; //переменная для суммы всех значений 'a'
int i = 0; //переменная для счетчика
int var = 0; //переменная для значения чсс

void setup() {
   Serial.begin(115200); 
   pinMode(A0, INPUT); //выставляем мод датчика как ввод информации
}

void loop(){
while(i != 60){ //пока i не будет равно 60, считываем и выводим среднее значение
   a = analogRead(A0); //присваиваем пеерменной 'a' значение с датчика 
   m = (a + m); //сумма всех значений 'a'
   delay(300); //задержка, чтобы не было одинаковых значений
   i++; 
   if(i = 10){
     m = 0;
   }
}
var = m / 50; //т. к. счетчик срабатывает 60 раз, то и значение в 60 раз меньше
var = var / 6; //деление числа на коэффициэнт 
  
/* 
 в зависимости от занчения переменнной 'var', будет выводиться значение ЧСС, 
 а в дальнейшем и советы по снижению стресса (если это небходимо)
*/

if(var <= 65){
  Serial.print("Пульс понижен.");
  Serial.println(var);
}

else if(65 < var and var <= 85){
  Serial.print("Пульс в норме.");
  Serial.println(var);
}

else if(85 < var){
  Serial.print("Пульс повышен.");
  Serial.println(var);
    }   
}
